## drivers/smem/Kconfig
```kconfig
menuconfig SMEM
	bool  "SMEM (Shared Memory mamanger) support"

config SPL_SMEM
	bool "Shared Memory Manager (SMEM) uclass support in SPL"
	depends on SPL && SMEM
	help
	  Build the SMEM uclass into SPL. Required by any SPL_*_SMEM driver
	  (e.g. SPL_MSM_SMEM). Selected automatically by drivers that need
	  the uclass in SPL.

if SMEM

config SANDBOX_SMEM
    bool "Sandbox Shared Memory Manager (SMEM)"
    depends on SANDBOX && DM
    help
      enable SMEM support for sandbox. This is an emulation of a real SMEM
      manager.
      The sandbox driver allocates a shared memory from the heap and
      initialzies it on start.

config MSM_SMEM
    bool "Qualcomm Shared Memory Manager (SMEM)"
    depends on DM
    depends on ARCH_SNAPDRAGON || ARCH_IPQ40XX
    select DEVRES
    help
      Enable support for the Qualcomm Shared Memory Manager.
      The driver provides an interface to items in a heap shared among all
      processors in a Qualcomm platform.

config SPL_MSM_SMEM
    bool "Qualcomm Shared Memory Manager (SMEM) in SPL"
    depends on SPL && MSM_SMEM
    select SPL_SMEM
    help
      Build the Qualcomm SMEM driver core into SPL. Only the read path
      (qcom_smem_get) and the DM-free early init (qcom_smem_init_early)
      are included; the DM probe/allocation paths are compiled out.
      This is intended for chainloaded SPL that needs to read socinfo
      before the device tree is selected.

config SPL_MSM_SMEM_BASE
    hex "Physical base address of SMEM (SPL early-init)"
    depends on SPL_MSM_SMEM
    default 0x86000000
    help
      Physical base address of the main Qualcomm SMEM region, used by
      qcom_smem_init_early() in chainloaded SPL where the SMEM driver
      cannot discover its base via the device tree (because DT selection
      itself depends on socinfo, which lives in SMEM). The default
      (0x86000000) is correct for sdm845; pick the value for your SoC.
      The region is identity-mapped, so no ioremap is performed.

config SPL_MSM_SMEM_SIZE
    hex "Size of SMEM region (SPL early-init)"
    depends on SPL_MSM_SMEM
    default 0x200000
    help
      Size of the Qualcomm SMEM region in bytes. Used together with
      SPL_MSM_SMEM_BASE for the SPL early-init path. The default
      (2 MiB) is suitable for sdm845 and most modern Qualcomm SoCs.

endif # menu "SMEM Support"
```

## drivers/soc/qcom/Kconfig
```kconfig
# SPDX-License-Identifier: GPL-2.0-only
#
# QCOM Soc drivers
#
menuconfig SOC_QCOM
	bool "Qualcomm SOC drivers support"
	depends on ARM64
	help
	  Say Y here if you want to enable Qualcomm SOC drivers support.

config SPL_SOC_QCOM
	bool "Qualcomm SOC drivers support in SPL"
	depends on SPL && SOC_QCOM
	help
	  Build the Qualcomm SOC drivers subdirectory for SPL. Individual
	  drivers still need their own SPL_* Kconfig symbol to be built.

if SOC_QCOM

config QCOM_COMMAND_DB
	bool "Qualcomm Command DB"
	help
	  Command DB queries shared memory by key string for shared system
	  resources. Platform drivers that require to set state of a shared
	  resource on a RPM-hardened platform must use this database to get
	  SoC specific identifier and information for the shared resources.

config QCOM_RPMH
	bool "Qualcomm RPMh support"
	depends on QCOM_COMMAND_DB
	help
	  Say y here to support the Qualcomm RPMh (resource peripheral manager)
	  if you need to control regulators on Qualcomm platforms, say y here.

config QCOM_SOCINFO
	bool "Qualcomm Socinfo support"
	depends on SMEM
	help
	  Say y here to support the Qualcomm socinfo driver which provides
	  information about the SoC ID, hardware platform, revision, and other
	  board identification information stored in SMEM.

config SPL_QCOM_SOCINFO
	bool "Qualcomm Socinfo support in SPL"
	depends on SPL_SOC_QCOM && SPL_MSM_SMEM && QCOM_SOCINFO
	help
	  Build the Qualcomm socinfo driver into SPL so the chainloaded SPL
	  can identify the SoC and hardware platform before the device tree
	  is selected. Requires SPL_MSM_SMEM for the underlying SMEM access.

endif # SOC_QCOM
```
